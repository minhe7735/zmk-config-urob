/* Homerow mods */

#define KEYS_L LT0 LT1 LT2 LT3 LT4 LT5 LM0 LM1 LM2 LM3 LM4 LM5 LB0 LB1 LB2 LB3 LB4 LB5  // left hand
#define KEYS_R RT0 RT1 RT2 RT3 RT4 RT5 RM0 RM1 RM2 RM3 RM4 RM5 RB0 RB1 RB2 RB3 RB4 RB5  // right hand
#define THUMBS LH2 LH1 LH0 RH0 RH1 RH2                                      // thumbs

#define MAKE_HRM(NAME, HOLD, TAP, TRIGGER_POS) \
    ZMK_BEHAVIOR(NAME, hold_tap, \
        flavor = "balanced"; \
        tapping-term-ms = <280>; \
        quick-tap-ms = <QUICK_TAP_MS>; \
        global-quick-tap-ms = <150>; \
        bindings = <HOLD>, <TAP>; \
        hold-trigger-key-positions = <TRIGGER_POS>; \
        hold-trigger-on-release; \
    )
MAKE_HRM(hml, &kp, &kp, KEYS_R THUMBS)  // left-hand HRMs
MAKE_HRM(hmr, &kp, &kp, KEYS_L THUMBS)  // right-hand HRMs
MAKE_HRM(hmr_cml, &cml, &kp, KEYS_L THUMBS)  // right-hand HRMs + move left
MAKE_HRM(hmr_smd, &smd, &kp, KEYS_L THUMBS)  // right-hand HRMs + move down
MAKE_HRM(hmr_amr, &amr, &kp, KEYS_L THUMBS)  // right-hand HRMs + move right


//MAKE_HRM(hmr_mouse_tp, &kp, &sl, KEYS_L THUMBS) // to mouse layer combo


/* Caps-word */

// tap: sticky-shift | shift + tap/ double-tap: caps-word | hold: shift
ZMK_BEHAVIOR(smart_shft, mod_morph,
    bindings = <&sk LSHFT>, <&caps_word>;
    mods = <(MOD_LSFT)>;
)


/*mod move*/

#define MAKE_MM(NAME, MOVE, MOD) \
    ZMK_BEHAVIOR(NAME, macro, \
        wait-ms = <0>; \
        tap-ms = <0>; \
        bindings = <&macro_press &mmv MOVE &kp MOD>, \
        <&macro_pause_for_release>, \
        <&macro_release &mmv MOVE &kp MOD>; \
    )

MAKE_MM(cml, MOVE_LEFT, RCTRL)
MAKE_MM(smd, MOVE_DOWN, RSHFT)
MAKE_MM(amr, MOVE_RIGHT, RALT)


/*mod tap*/

#define MAKE_MT(NAME, HOLD, TAP) \
    ZMK_BEHAVIOR(NAME, hold_tap, \
        flavor = "tap-preferred"; \
        tapping-term-ms = <200>; \
        quick-tap-ms = <QUICK_TAP_MS>; \
        bindings = <HOLD>, <TAP>; \
    )

MAKE_MT(mt_mouse, &mmv, &kp) // hold: move, tap: key
MAKE_MT(mt_wheel, &mwh, &kp) // hold: scroll, tap: key

MAKE_MT(LMT1_mt,  &LMT1,  &LMT4)
MAKE_MT(LMT2_mt,  &LMT2,  &LMT5)
MAKE_MT(LMT3_mt,  &LMT3,  &LMT6)
MAKE_MT(LMT13_mt, &LMT13, &LMT10)
MAKE_MT(LMT14_mt, &LMT14, &LMT11)
MAKE_MT(LMT15_mt, &LMT15, &LMT12)

MAKE_MT(RMT1_mt,  &RMT1,  &RMT2)
MAKE_MT(RMT5_mt,  &RMT5,  &RMT4)
MAKE_MT(RMT6_mt,  &RMT6,  &RMT7)
MAKE_MT(RMT10_mt, &RMT10, &RMT9)
MAKE_MT(RMT11_mt, &RMT11, &RMT12)
MAKE_MT(RMT15_mt, &RMT15, &RMT14)

MAKE_MT(mt_layer, &to, &sl)

MAKE_MT(mt_mtp_up,      &mmv, &RMT3)
MAKE_MT(mt_mtp_down,    &mmv, &RMT8)
MAKE_MT(mt_mtp_left,    &mmv, &RMT7)
MAKE_MT(mt_mtp_right,   &mmv, &RMT9)
MAKE_MT(mt_mtp_s_up,    &mwh, &RMT1)
MAKE_MT(mt_mtp_s_down,  &mwh, &RMT6)
MAKE_MT(mt_mtp_s_left,  &mwh, &RMT2)
MAKE_MT(mt_mtp_s_right, &mwh, &RMT4)


// Alt+Tab swapper, requires PR #1366
ZMK_BEHAVIOR(swapper, tri_state,
    bindings = <&kt LALT>, <&kp TAB>, <&kt LALT>;
    ignored-key-positions = <LT2>;
)


/*mod morphs for mouse tp*/

#define MAKE_MMTP(NAME, POINT1, POINT2) \
    ZMK_BEHAVIOR(NAME, mod_morph, \
        bindings = <POINT1>, <POINT2>; \
        mods = <(MOD_LSFT|MOD_RSFT)>; \
    )

MAKE_MMTP(LMT1_morph, &LMT1, &LMT4)
MAKE_MMTP(LMT2_morph, &LMT2, &LMT5)
MAKE_MMTP(LMT3_morph, &LMT3, &LMT6)
MAKE_MMTP(LMT13_morph, &LMT13, &LMT10)
MAKE_MMTP(LMT14_morph, &LMT14, &LMT11)
MAKE_MMTP(LMT15_morph, &LMT15, &LMT12)

MAKE_MMTP(RMT1_morph, &RMT1, &RMT2)
MAKE_MMTP(RMT5_morph, &RMT5, &RMT4)
MAKE_MMTP(RMT6_morph, &RMT6, &RMT7)
MAKE_MMTP(RMT10_morph, &RMT10, &RMT9)
MAKE_MMTP(RMT11_morph, &RMT11, &RMT12)
MAKE_MMTP(RMT15_morph, &RMT15, &RMT14)


/*teleport cursor*/

/ {
	behaviors {
		mmvt: mmvt {
			compatible = "zmk,behavior-mouse-move";
			label = "MOUSE_MOVE_TP";
			#binding-cells = <1>;
			delay-ms = <0>;
			time-to-max-speed-ms = <0>;
			acceleration-exponent = <0>;
		};
	};
};


#define M_START_Y &mmvt MOVE_VERT(-30000)// top left
#define M_START_X &mmvt MOVE_HOR(-30000)// top left
#define RES_LONG 1920
#define RES_SHORT 1080
#define SHORT_SEC 3
#define LONG_SEC 5
#define M_L_DIV (RES_LONG/LONG_SEC)
#define M_LH_DIV (M_L_DIV/2)
#define M_S_DIV (RES_SHORT/SHORT_SEC)
#define M_SH_DIV (M_S_DIV/2)
#define M_SCALE 10
#define OFFSET 429

#define DEF_POINTS(NAME, OFFSET_X, OFFSET_Y, DX, DY, MX, MY) \
    ZMK_BEHAVIOR(NAME, macro, \
        bindings = <&macro_tap M_START_X>, \
        <&macro_tap M_START_X>, \
        <&macro_tap M_START_X>, \
        <&macro_tap M_START_Y>, \
        <&macro_tap M_START_Y>, \
        <&macro_tap M_START_Y>, \
        <&macro_tap &mmvt MOVE_VERT((OFFSET_Y + MY * DY) * M_SCALE)>,\
        <&macro_tap &mmvt MOVE_VERT((OFFSET_Y + MY * DY) * M_SCALE)>,\
        <&macro_tap &mmvt MOVE_VERT((OFFSET_Y + MY * DY) * M_SCALE)>,\
        <&macro_tap &mmvt MOVE_HOR((OFFSET_X + MX * DX) * M_SCALE)>,\
        <&macro_tap &mmvt MOVE_HOR((OFFSET_X + MX * DX) * M_SCALE)>,\
        <&macro_tap &mmvt MOVE_HOR((OFFSET_X + MX * DX) * M_SCALE)> ;\
    )



//vertical left
DEF_POINTS(LMT1,  M_SH_DIV, M_LH_DIV, M_S_DIV, M_L_DIV, 0, 0)
DEF_POINTS(LMT2,  M_SH_DIV, M_LH_DIV, M_S_DIV, M_L_DIV, 1, 0)
DEF_POINTS(LMT3,  M_SH_DIV, M_LH_DIV, M_S_DIV, M_L_DIV, 2, 0)
DEF_POINTS(LMT4,  M_SH_DIV, M_LH_DIV, M_S_DIV, M_L_DIV, 0, 1)
DEF_POINTS(LMT5,  M_SH_DIV, M_LH_DIV, M_S_DIV, M_L_DIV, 1, 1)
DEF_POINTS(LMT6,  M_SH_DIV, M_LH_DIV, M_S_DIV, M_L_DIV, 2, 1)
DEF_POINTS(LMT7,  M_SH_DIV, M_LH_DIV, M_S_DIV, M_L_DIV, 0, 2)
DEF_POINTS(LMT8,  M_SH_DIV, M_LH_DIV, M_S_DIV, M_L_DIV, 1, 2)
DEF_POINTS(LMT9,  M_SH_DIV, M_LH_DIV, M_S_DIV, M_L_DIV, 2, 2)
DEF_POINTS(LMT10, M_SH_DIV, M_LH_DIV, M_S_DIV, M_L_DIV, 0, 3)
DEF_POINTS(LMT11, M_SH_DIV, M_LH_DIV, M_S_DIV, M_L_DIV, 1, 3)
DEF_POINTS(LMT12, M_SH_DIV, M_LH_DIV, M_S_DIV, M_L_DIV, 2, 3)
DEF_POINTS(LMT13, M_SH_DIV, M_LH_DIV, M_S_DIV, M_L_DIV, 0, 4)
DEF_POINTS(LMT14, M_SH_DIV, M_LH_DIV, M_S_DIV, M_L_DIV, 1, 4)
DEF_POINTS(LMT15, M_SH_DIV, M_LH_DIV, M_S_DIV, M_L_DIV, 2, 4)




//horizontal right
DEF_POINTS(RMT1,  M_LH_DIV + RES_SHORT, M_SH_DIV + OFFSET, M_L_DIV, M_S_DIV, 0, 0)
DEF_POINTS(RMT2,  M_LH_DIV + RES_SHORT, M_SH_DIV + OFFSET, M_L_DIV, M_S_DIV, 1, 0)
DEF_POINTS(RMT3,  M_LH_DIV + RES_SHORT, M_SH_DIV + OFFSET, M_L_DIV, M_S_DIV, 2, 0)
DEF_POINTS(RMT4,  M_LH_DIV + RES_SHORT, M_SH_DIV + OFFSET, M_L_DIV, M_S_DIV, 3, 0)
DEF_POINTS(RMT5,  M_LH_DIV + RES_SHORT, M_SH_DIV + OFFSET, M_L_DIV, M_S_DIV, 4, 0)
DEF_POINTS(RMT6,  M_LH_DIV + RES_SHORT, M_SH_DIV + OFFSET, M_L_DIV, M_S_DIV, 0, 1)
DEF_POINTS(RMT7,  M_LH_DIV + RES_SHORT, M_SH_DIV + OFFSET, M_L_DIV, M_S_DIV, 1, 1)
DEF_POINTS(RMT8,  M_LH_DIV + RES_SHORT, M_SH_DIV + OFFSET, M_L_DIV, M_S_DIV, 2, 1)
DEF_POINTS(RMT9,  M_LH_DIV + RES_SHORT, M_SH_DIV + OFFSET, M_L_DIV, M_S_DIV, 3, 1)
DEF_POINTS(RMT10, M_LH_DIV + RES_SHORT, M_SH_DIV + OFFSET, M_L_DIV, M_S_DIV, 4, 1)
DEF_POINTS(RMT11, M_LH_DIV + RES_SHORT, M_SH_DIV + OFFSET, M_L_DIV, M_S_DIV, 0, 2)
DEF_POINTS(RMT12, M_LH_DIV + RES_SHORT, M_SH_DIV + OFFSET, M_L_DIV, M_S_DIV, 1, 2)
DEF_POINTS(RMT13, M_LH_DIV + RES_SHORT, M_SH_DIV + OFFSET, M_L_DIV, M_S_DIV, 2, 2)
DEF_POINTS(RMT14, M_LH_DIV + RES_SHORT, M_SH_DIV + OFFSET, M_L_DIV, M_S_DIV, 3, 2)
DEF_POINTS(RMT15, M_LH_DIV + RES_SHORT, M_SH_DIV + OFFSET, M_L_DIV, M_S_DIV, 4, 2)

/*tap dance*/

ZMK_BEHAVIOR(mouse_dance, tap_dance,
    tapping-term-ms = <200>;
    bindings = <&sl MOUSE>, <&to MOUSE>;  // reverse this for sticky-num on single tap
)

/*hrm mod morphs*/
#define MAKE_MOD_MORPHS(NAME, KEY, MORPH) \
    ZMK_BEHAVIOR(NAME, mod_morph, \
        bindings = <KEY>, <MORPH>; \
        mods = <(MOD_LSFT|MOD_LCTL|MOD_RALT|MOD_RGUI)>, \
        keep-mods = <(MOD_LSFT|MOD_LCTL|MOD_RALT|MOD_RGUI)>;; \
    )

#define MAKE_TD_MOD_MORPHS(NAME, KEY) \
    ZMK_BEHAVIOR(NAME, tap_dance, \
        tapping-term-ms = <200>; \
        bindings = <&none>, <KEY>; \
    )

MAKE_TD_MOD_MORPHS(td_A, &kp A)
MAKE_TD_MOD_MORPHS(td_B, &kp B)
MAKE_TD_MOD_MORPHS(td_C, &kp C)
MAKE_TD_MOD_MORPHS(td_D, &kp D)
MAKE_TD_MOD_MORPHS(td_E, &kp E)
MAKE_TD_MOD_MORPHS(td_F, &kp F)
MAKE_TD_MOD_MORPHS(td_G, &kp G)
MAKE_TD_MOD_MORPHS(td_H, &kp H)
MAKE_TD_MOD_MORPHS(td_I, &kp I)
MAKE_TD_MOD_MORPHS(td_J, &kp J)
MAKE_TD_MOD_MORPHS(td_K, &kp K)
MAKE_TD_MOD_MORPHS(td_L, &kp L)
MAKE_TD_MOD_MORPHS(td_M, &kp M)
MAKE_TD_MOD_MORPHS(td_N, &kp N)
MAKE_TD_MOD_MORPHS(td_O, &kp O)
MAKE_TD_MOD_MORPHS(td_P, &kp P)
MAKE_TD_MOD_MORPHS(td_Q, &kp Q)
MAKE_TD_MOD_MORPHS(td_R, &kp R)
MAKE_TD_MOD_MORPHS(td_S, &kp S)
MAKE_TD_MOD_MORPHS(td_T, &kp T)
MAKE_TD_MOD_MORPHS(td_U, &kp U)
MAKE_TD_MOD_MORPHS(td_V, &kp V)
MAKE_TD_MOD_MORPHS(td_W, &kp W)
MAKE_TD_MOD_MORPHS(td_X, &kp X)
MAKE_TD_MOD_MORPHS(td_Y, &kp Y)
MAKE_TD_MOD_MORPHS(td_Z, &kp Z)

MAKE_MOD_MORPHS(mm_A, &kp A, &td_A)
MAKE_MOD_MORPHS(mm_B, &kp B, &td_B)
MAKE_MOD_MORPHS(mm_C, &kp C, &td_C)
MAKE_MOD_MORPHS(mm_D, &kp D, &td_D)
MAKE_MOD_MORPHS(mm_E, &kp E, &td_E)
MAKE_MOD_MORPHS(mm_F, &kp F, &td_F)
MAKE_MOD_MORPHS(mm_G, &kp G, &td_G)
MAKE_MOD_MORPHS(mm_H, &kp H, &td_H)
MAKE_MOD_MORPHS(mm_I, &kp I, &td_I)
MAKE_MOD_MORPHS(mm_J, &kp J, &td_J)
MAKE_MOD_MORPHS(mm_K, &kp K, &td_K)
MAKE_MOD_MORPHS(mm_L, &kp L, &td_L)
MAKE_MOD_MORPHS(mm_M, &kp M, &td_M)
MAKE_MOD_MORPHS(mm_N, &kp N, &td_N)
MAKE_MOD_MORPHS(mm_O, &kp O, &td_O)
MAKE_MOD_MORPHS(mm_P, &kp P, &td_P)
MAKE_MOD_MORPHS(mm_Q, &kp Q, &td_Q)
MAKE_MOD_MORPHS(mm_R, &kp R, &td_R)
MAKE_MOD_MORPHS(mm_S, &kp S, &td_S)
MAKE_MOD_MORPHS(mm_T, &kp T, &td_T)
MAKE_MOD_MORPHS(mm_U, &kp U, &td_U)
MAKE_MOD_MORPHS(mm_V, &kp V, &td_V)
MAKE_MOD_MORPHS(mm_W, &kp W, &td_W)
MAKE_MOD_MORPHS(mm_X, &kp X, &td_X)
MAKE_MOD_MORPHS(mm_Y, &kp Y, &td_Y)
MAKE_MOD_MORPHS(mm_Z, &kp Z, &td_Z)

MAKE_MT(gui_mm_A,  &kp,  &mm_A)
MAKE_MT(alt_mm_R,  &kp,  &mm_R)
MAKE_MT(shft_mm_S, &kp,  &mm_S)
MAKE_MT(ctrl_mm_T, &kp,  &mm_T)

MAKE_MT(ctrl_mm_N,  &cml, &mm_N)
MAKE_MT(shft_mm_E,  &smd, &mm_E)
MAKE_MT(alt_mm_I,   &amr, &mm_I)
MAKE_MT(gui_mm_O,   &kp,  &mm_O)

MAKE_MT(sd_mm_M, &mwh, &mm_M)
MAKE_MT(su_mm_J, &mwh, &mm_J)
MAKE_MT(sl_mm_L, &mwh, &mm_L)
MAKE_MT(mu_mm_U, &mmv, &mm_U)
MAKE_MT(sr_mm_Y, &mwh, &mm_Y)
