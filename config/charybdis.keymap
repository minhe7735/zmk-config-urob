/* source keypos definitions */
#include "../zmk-nodefree-config/keypos_def/keypos_36keys.h"

/* map Zen's extra keys */
#define X_LH  &mkp MB1  // thumb row, left


/* activate bluetooth */
#define CONFIG_WIRELESS 1

/* source the main keymap */
#include "base.keymap"
/ {
    chosen { zmk,matrix_transform = &five_column_transform; };
};