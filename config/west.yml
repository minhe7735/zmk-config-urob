## config/west.yml
```yaml
manifest:
  remotes:
    - name: minhe7735
      url-base: https://github.com/minhe7735
    - name: badjeff
      url-base: https://github.com/badjeff
  projects:
    - name: zmk
      remote: minhe7735
      revision: urob
      import: app/west.yml
    - name: zmk-pmw3610-driver
      remote: minhe7735
      revision: main
    - name: zmk-split-peripheral-input-relay
      remote: badjeff
      revision: main
    - name: zmk-input-behavior-listener
      remote: badjeff
      revision: main
  self:
    path: config
```
