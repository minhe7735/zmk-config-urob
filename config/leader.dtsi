/*
leader
/*                                      42 KEY MATRIX / LAYOUT MAPPING

  ╭────────────────────────┬────────────────────────╮ 
  │  0   1   2   3   4   5 │  6   7   8   9  10  11 │ 
  │ 12  13  14  15  16  17 │ 18  19  20  21  22  23 │ 
  │ 24  25  26  27  28  29 │ 30  31  32  33  34  35 │ 
  ╰───────────╮ 36  37  38 │ 39  40  41 ╭───────────╯ 
              ╰────────────┴────────────╯             */

#pragma once

#define _B  5  // left-top row
#define _P  4
#define _F  3
#define _W  2
#define _FSLASH  1
#define _ESC  0
#define _J  6  // right-top row
#define _L  7
#define _U  8
#define _Y  9
#define _SEMI 10
#define _G 17  // left-middle row
#define _T 16
#define _S 15
#define _R 14
#define _A 13
#define _TAB 12
#define _M 18  // right-middle row
#define _N 19
#define _E 20
#define _I 21
#define _O 22
#define _V 29  // left-bottom row
#define _D 28
#define _C 27
#define _X 26
#define _Z 25
#define _K 30  // right-bottom row
#define _H 31
#define _COMMA 32
#define _DOT 33
#define _Q 34


#define LEADER(NAME, KEYS, BINDINGS, LAYERS) \
    leader_##NAME { \
        key-positions = <KEYS>; \
        bindings = <BINDINGS>; \
        layers = <LAYERS>; \
        immediate-trigger; \
    };

// #define MACRO_MAKER(NAME, SEQUENCE) \
//     ZMK_BEHAVIOR(NAME, macro, \
//         bindings = <&macro_tap SEQUENCE>; \
//     )

// MACRO_MAKER(test, &kp T &kp E &kp S &kp T)

/{ 
    leader_sequences {
        compatible = "zmk,leader-sequences";
        LEADER(close, _E _X _I _T, &kp LA(F4), DEF);
        // LEADER(hello, _H _W, &hello_world, DEF);

        // //  buildProjects:
        // LEADER(newInThisDirectory, _N _B _D, &kp LC(LA(INS)), DEF)
        // LEADER(buildProject, _B _D, &kp LC(F9), DEF)
        // LEADER(rebuild, _R _B _D, &kp LC(LS(F9)), DEF)
        
        // //  basicEditing:
        //     // LEADER(cut, , &kp LC(X), DEF)
        //     // LEADER(copy, , &kp LC(C), DEF)
        //     // LEADER(paste, , &kp LC(V), DEF)
        // LEADER(pasteAsPlainText, _P _T, &kp LC(LA(LS(V))), DEF)
        // LEADER(pasteFromHistory, _P _H, &kp LC(LS(V)), DEF)
        // LEADER(copyPaths, _C _P, &kp LC(LS(C)), DEF)
        // LEADER(copyReference, _C _R, &kp LC(LA(LS(C))), DEF)
        //     // LEADER(saveAll, , &kp LC(S), DEF)
        //     // LEADER(undo, , &kp LC(Z), DEF)
        //     // LEADER(redo, , &kp LC(LS(Z)), DEF)
        //     // LEADER(indentSelection, , TAB, DEF)
        //     // LEADER(unindentLineOrSelection, , &kp LS(TAB), DEF)
        // LEADER(autoIndentLines, _A _I _L, &kp LC(LA(I)), DEF)
        // LEADER(startNewLine, _N _L _N, &kp LS(ENTER), DEF)
        // LEADER(startNewLineBeforeCurrent, _N _L _P, &kp LC(LA(ENTER)), DEF)
        // LEADER(deleteLine, _D _L, &kp LC(Y), DEF)
        // LEADER(joinLines, _J _L, &kp LC(LS(J)), DEF)
        // LEADER(duplicateLineOrSelection, _D _P _L, &kp LC(D), DEF)
        // LEADER(toggleCase, _T _C, &kp LC(LS(U)), DEF)
        // LEADER(scratchFile, _S _F, &kp LC(LA(LS(INS))), DEF)
        // LEADER(openSourceInNewWindow, _O _S _N, &kp LS(F4), DEF)
        // LEADER(increaseFontSizeInAllEditors, _I _F, &kp LA(LS(DOT)), DEF)
        // LEADER(decreaseFontSizeInAllEditors, _D _F, &kp LA(LS(COMMA)), DEF)
        
        // //  caretNavigation:
        //     // LEADER(moveCaretToPreviousWord, , &kp LC(LEFT), DEF)
        //     // LEADER(moveCaretToNextWord, , &kp LC(RIGHT), DEF)
        //     // LEADER(moveCaretToLineStart, , HOME, DEF)
        //     // LEADER(moveCaretToLineEnd, , END, DEF)
        // LEADER(moveCaretToMatchingBrace, _M _B, &kp LC(LS(M)), DEF)
        // LEADER(moveCaretToCodeBlockStart, _B _S, &kp LC(LBKT), DEF)
        // LEADER(moveCaretToCodeBlockEnd, _B _E, &kp LC(RBKT), DEF)
        // LEADER(nextMethod, _N _M, &kp LA(DOWN), DEF)
        // LEADER(previousMethod, _p _M, &kp LA(UP), DEF)
        //     // LEADER(moveCaretToPageTop, _M _P _T, &kp LC(PG_UP), DEF)
        //     // LEADER(moveCaretToPageBottom _M _P _B, , &kp LC(PG_DN), DEF)
        //     // LEADER(pageUp, , PG_UP, DEF)
        //     // LEADER(pageDown, , PG_DN, DEF)
        //     // LEADER(moveCaretToTextStart, , &kp LC(HOME), DEF)
        //     // LEADER(moveCaretToTextEnd, , &kp LC(END), DEF)
        
        // //  selectText:
        // // LEADER(selectAll, , &kp LC(A), DEF)
        //     // LEADER(leftWithSelection, , &kp LS(LEFT), DEF)
        //     // LEADER(rightWithSelection, , &kp LS(RIGHT), DEF)
        //     // LEADER(moveCaretToPreviousWordWithSelection, , &kp LC(LS(LEFT)), DEF)
        //     // LEADER(moveCaretToNextWordWithSelection, , &kp LC(LS(RIGHT)), DEF)
        //     // LEADER(moveCaretToLineStartWithSelection, , &kp LS(HOME), DEF)
        //     // LEADER(moveCaretToLineEndWithSelection, , &kp LS(END), DEF)
        //     // LEADER(upWithSelection, , &kp LS(UP), DEF)
        //     // LEADER(downWithSelection, , &kp LS(DOWN), DEF)
        // LEADER(moveCaretToCodeBlockStartWithSelection, _S _B _S, &kp LC(LS(LBKT)), DEF)
        // LEADER(moveCaretToCodeBlockEndWithSelection, _S _B _E, &kp LC(LS(RBKT)), DEF)
        //     // LEADER(moveCaretToPageTopWithSelection, , &kp LC(LS(PG_UP)), DEF)
        //     // LEADER(moveCaretToPageBottomWithSelection, , &kp LC(LS(PG_DN)), DEF)
        //     // LEADER(pageUpWithSelection, , &kp LS(PG_UP), DEF)
        //     // LEADER(pageDownWithSelection, , &kp LS(PG_DN), DEF)
        //     // LEADER(moveCaretToTextStartWithSelection, , &kp LC(LS(HOME)), DEF)
        //     // LEADER(moveCaretToTextEndWithSelection, , &kp LC(LS(END)), DEF)
        //     // LEADER(extendSelection, , &kp LC(W), DEF)
        //     // LEADER(shrinkSelection, , &kp LC(LS(W)), DEF)
        
        // //  codeFolding:
        // // LEADER(expand, _E _X, &kp LC(KP_PLUS), DEF)
        // // LEADER(collapse, _C _L, &kp LC(KP_MINUS), DEF)
        // LEADER(expandRecursively, _E _X _R, &kp LC(LA(KP_PLUS)), DEF)           
        // LEADER(collapseRecursively, _C _L _R, &kp LC(LA(KP_MINUS)), DEF)
        // LEADER(expandAll, _E _X _A, &kp LC(LS(KP_PLUS)), DEF)
        // LEADER(collapseAll, _C _L _A, &kp LC(LS(KP_MINUS)), DEF)
        // LEADER(foldSelection, , &kp LC(DOT), DEF)
        
        // //  multipleCaretsAndSelectionRanges:
        //     // LEADER(addRemoveCaret, , &kp LA(LS(MBTN1)), DEF)
        // LEADER(toggleColumnSelectionMode, , &kp LA(LS(INS)), DEF)
        // LEADER(cloneCaretAbove, , &kp LC(rc(UP)), DEF)
        // LEADER(cloneCaretBelow, , &kp LC(rc(DOWN)), DEF)
        // LEADER(addCaretToEachLineInSelection, , &kp LA(LS(G)), DEF)
        // LEADER(addSelectionForNextOccurrence, , &kp LA(J), DEF)
        // LEADER(selectAllOccurrences, , &kp LC(LA(LS(J))), DEF)
        // LEADER(deselectLastOccurrence, , &kp LA(LS(J)), DEF)
        //     // LEADER(createRectangularSelection, , &kp LA(LS(MBTN2)), DEF)
        //     // LEADER(dragToCreateRectangularSelection, , &kp LA(MBTN1), DEF)
        //     // LEADER(dragToCreateMultipleRectangularSelections, , &kp LC(LA(LS(MBTN1))), DEF)
        
        // //  codingAssistance:
        // LEADER(showIntentionActions, , &kp LA(ENTER), DEF)
        // LEADER(basicCompletion, , &kp LC(SPACE), DEF)
        // LEADER(typeMatchingCompletion, , &kp LC(LS(SPACE)), DEF)
        // LEADER(secondBasicCompletion, , &kp LC(LA(SPACE)), DEF)
        // LEADER(completeCurrentStatement, , &kp LC(LS(ENTER)), DEF)
        // LEADER(reformatCode, , &kp LC(LA(L)), DEF)
        // LEADER(parameterInfo, , &kp LC(P), DEF)
        // LEADER(quickDocumentation, , &kp LC(Q), DEF)
        // LEADER(moveStatementUp, , &kp LC(LS(UP)), DEF)
        // LEADER(moveStatementDown, , &kp LC(LS(DOWN)), DEF)
        // LEADER(moveElementLeft, , &kp LC(LA(LS(LEFT))), DEF)
        // LEADER(moveStatementRight, , &kp LC(LA(LS(RIGHT))), DEF)
        // LEADER(moveLineUp, , &kp LA(LS(UP)), DEF)
        // LEADER(moveLineDown, , &kp LA(LS(DOWN)), DEF)
        // LEADER(commentWithLineComment, , &kp LC(SLASH), DEF)
        // LEADER(commentWithBlockComment, , &kp LC(LS(SLASH)), DEF)
        // LEADER(surroundWith, , &kp LC(LA(T)), DEF)
        // LEADER(generate, , &kp LA(INS), DEF)
        
        // //  contextNavigation:
        // LEADER(nextMethod, , &kp LA(DOWN), DEF)
        // LEADER(previousMethod, , &kp LA(UP), DEF)
        // LEADER(goToLineColumn, , &kp LC(G), DEF)
        // LEADER(switcher, , &kp LC(TAB), DEF)
        // LEADER(selectIn, , &kp LA(F1), DEF)
        // LEADER(recentFiles, , &kp LC(E), DEF)
        // LEADER(lastEditLocation, , &kp LC(LS(BKSPC)), DEF)
        // LEADER(back, , &kp LC(LA(LEFT)), DEF)
        // LEADER(forward, , &kp LC(LA(RIGHT)), DEF)
        // LEADER(selectNextTab, , &kp LA(RIGHT), DEF)
        // LEADER(selectPreviousTab, , &kp LA(LEFT), DEF)
        // LEADER(toggleAnonymousBookmark, , &kp F11, DEF)
        // //  LEADER(toggleBookmarkWithDigit, , &kp LC(LS(, DEF)comJetbrainsWebhelpShortcutteryShortcutsKeyCustom1076e435))
        // LEADER(toggleBookmarkWithMnemonic, , &kp LC(F11), DEF)
        // LEADER(showAllBookmarks, , &kp LS(F11), DEF)
        // //  LEADER(goToBookmarkWithDigit, , &kp LC(, DEF)comJetbrainsWebhelpShortcutteryShortcutsKeyCustom22a3022d)
        // LEADER(showMnemonicBookmarks, , &kp LC(LS(F11)), DEF)
        // LEADER(showBookmarksWindow, , &kp LA(N2), DEF)
        // LEADER(showStructureWindow, , &kp LA(N7), DEF)
        // LEADER(showFindWindow, , &kp LA(N3), DEF)
        // LEADER(nextOccurrence, , &kp LC(LA(DOWN)), DEF)
        // LEADER(previousOccurrence, , &kp LC(LA(UP)), DEF)
        
        // //  findEverything:
        // LEADER(searchEverywhere, , &kp LS(rs(N2)), DEF)
        // LEADER(find, , &kp LC(F), DEF)
        // LEADER(findNextMoveToNextOccurrence, , &kp F3, DEF)
        // LEADER(findPreviousMoveToPreviousOccurrence, , &kp LS(F3), DEF)
        // LEADER(replace, , &kp LC(R), DEF)
        // LEADER(findInFiles, , &kp LC(LS(F)), DEF)
        // LEADER(replaceInFiles, , &kp LC(LS(R)), DEF)
        // LEADER(nextOccurrenceOfTheWordAtCaret, , &kp LC(F3), DEF)
        // LEADER(goToFile, , &kp LC(LS(N)), DEF)
        // LEADER(fileStructure, , &kp LC(F12), DEF)
        // LEADER(goToSymbol, , &kp LC(LA(LS(N))), DEF)
        // LEADER(findAction, , &kp LC(LS(A)), DEF)
        
        // // navigateFromSymbols:
        // LEADER(findUsages, , &kp LA(F7), DEF)
        // LEADER(goToDeclarationOrUsages, , &kp LC(B), DEF)
        // LEADER(goToTypeDeclaration, , &kp LC(LS(B)), DEF)
        // LEADER(showUsages, , &kp LC(LA(F7)), DEF)
        // LEADER(goToSuperMethod, , &kp LC(U), DEF)
        // LEADER(goToImplementations, , &kp LC(LA(B)), DEF)
        // LEADER(goToTest, , &kp LC(LS(T)), DEF)
        // LEADER(highlightUsagesInFile, , &kp LC(LS(F7)), DEF)
        
        // //  codeAnalysis:
        // LEADER(showIntentionActions, , &kp LA(ENTER), DEF)
        // LEADER(errorDescription, , &kp LC(F1), DEF)
        // LEADER(nextHighlightedError, , &kp F2, DEF)
        // LEADER(previousHighlightedError, , &kp LS(F2), DEF)
        // LEADER(runInspectionByName, , &kp LC(LA(LS(I))), DEF)
        // LEADER(showProblemsWindow, , &kp LA(N6), DEF)
        
        // //  runAndDebug:
        // LEADER(runAnything, , &kp LC(rc(N0)), DEF)
        // LEADER(runContextConfiguration, , &kp LS(F10), DEF)
        // LEADER(run, , &kp LA(LS(F10)), DEF)
        // LEADER(debugContextConfiguration, , &kp LS(F9), DEF)
        // LEADER(debug, , &kp LA(LS(F9)), DEF)
        // LEADER(attachToProcess, , &kp LC(LA(F5)), DEF)
        // LEADER(stop, , &kp LC(F2), DEF)
        // LEADER(resumeProgram, , &kp F9, DEF)
        // LEADER(stopBackgroundProcesses, , &kp LC(LS(F2)), DEF)
        // LEADER(stepOver, , &kp F8, DEF)
        // LEADER(forceStepOver, , &kp LA(LS(F8)), DEF)
        // LEADER(stepInto, , &kp F7, DEF)
        // LEADER(smartStepInto, , &kp LS(F7), DEF)
        // LEADER(forceStepInto, , &kp LA(LS(F7)), DEF)
        // LEADER(stepOut, , &kp LS(F8), DEF)
        // LEADER(runToCursor, , &kp LA(F9), DEF)
        // LEADER(forceRunToCursor, , &kp LC(LA(F9)), DEF)
        // LEADER(showExecutionPoint, , &kp LA(F10), DEF)
        // LEADER(evaluateExpression, , &kp LA(F8), DEF)
        // LEADER(quickEvaluateExpression, , &kp LC(LA(F8)), DEF)
        // LEADER(toggleLineBreakpoint, , &kp LC(F8), DEF)
        // LEADER(toggleTemporaryLineBreakpoint, , &kp LC(LA(LS(F8))), DEF)
        // LEADER(viewBreakpoints, , &kp LC(LS(F8)), DEF)
        // LEADER(editBreakpoint, , &kp LC(LS(F8)), DEF)
        // LEADER(showRunWindow, , &kp LA(N4), DEF)
        // LEADER(showDebugWindow, , &kp LA(N5), DEF)
        // LEADER(showServicesWindow, , &kp LA(N8), DEF)
        
        // //  refactorings:
        // LEADER(refactorThis, , &kp LC(LA(LS(T))), DEF)
        // LEADER(rename, , &kp LS(F6), DEF)
        // LEADER(changeSignature, , &kp LC(F6), DEF)
        // LEADER(inline, , &kp LC(LA(N)), DEF)
        // LEADER(move, , &kp F6, DEF)
        // LEADER(extractMethod, , &kp LC(LA(M)), DEF)
        // LEADER(introduceField, , &kp LC(LA(F)), DEF)
        // LEADER(introduceParameter, , &kp LC(LA(P)), DEF)
        // LEADER(introduceVariable, , &kp LC(LA(V)), DEF)
        // LEADER(safeDelete, , &kp LA(DEL), DEF)
        
        // //  globalVCSActions:
        // LEADER(vcsOperationsPopup, , &kp LA(GRV), DEF)
        // LEADER(commit, , &kp LC(K), DEF)
        // LEADER(updateProject, , &kp LC(T), DEF)
        // LEADER(rollback, , &kp LC(LA(Z)), DEF)
        // LEADER(push, , &kp LC(LS(K)), DEF)
        // LEADER(nextChange, , &kp LC(LA(LS(DOWN))), DEF)
        // LEADER(previousChange, , &kp LC(LA(LS(UP))), DEF)
        // LEADER(showVersionControlWindow, , &kp LA(N9), DEF)
        // LEADER(showCommitWindow, , &kp LA(N0), DEF)
        
        // //  differencesViewer:
        // LEADER(showDiff, , &kp LC(D), DEF)
        // LEADER(compareFiles, , &kp LC(D), DEF)
        // LEADER(nextDifference, , &kp F7, DEF)
        // LEADER(previousDifference, , &kp LS(F7), DEF)
        // LEADER(acceptLeftSide, , &kp LC(LA(R)), DEF)
        // LEADER(acceptRightSide, , &kp LC(LA(A)), DEF)
        // LEADER(selectOppositeDiffPane, , &kp LC(LS(TAB)), DEF)
        // LEADER(showDiffSettingsPopup, , &kp LC(LS(D)), DEF)
        
        // //  toolWindows:
        // LEADER(hideActiveToolWindow, , &kp LS(ESC), DEF)
        // LEADER(hideAllToolWindows, , &kp LC(LS(F12)), DEF)
        // LEADER(jumpToLastToolWindow, , &kp F12, DEF)
        // LEADER(stretchToLeft, , &kp LC(LA(LS(LEFT))), DEF)
        // LEADER(stretchToRight, , &kp LC(LA(LS(RIGHT))), DEF)
        // LEADER(stretchToTop, , &kp LC(LA(LS(UP))), DEF)
        // LEADER(stretchToBottom, , &kp LC(LA(LS(DOWN))), DEF)
        // LEADER(showProjectWindow, , &kp LA(N1), DEF)
        // LEADER(showBookmarksWindow, , &kp LA(N2), DEF)
        // LEADER(showFindWindow, , &kp LA(N3), DEF)
        // LEADER(showRunWindow, , &kp LA(N4), DEF)
        // LEADER(showDebugWindow, , &kp LA(N5), DEF)
        // LEADER(showProblemsWindow, , &kp LA(N6), DEF)
        // LEADER(showStructureWindow, , &kp LA(N7), DEF)
        // LEADER(ShowServicesWindow, , &kp LA(N8), DEF)
        // LEADER(ShowVersionControl, , window LA(N9), DEF)
        // LEADER(ShowCommitWindow, , &kp LA(N0), DEF)
        // LEADER(ShowTerminalWindow, , &kp LA(F12), DEF)
    };
};